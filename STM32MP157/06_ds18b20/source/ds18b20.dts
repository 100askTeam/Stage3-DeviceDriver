

   ds18b20 {  /* for stm32mp157 */
        compatible = "100ask,ds18b20";
        gpios = <&gpioc 3 GPIO_ACTIVE_HIGH>;
    };

   ds18b20 {  /* for imx6ull */
        compatible = "100ask,ds18b20";
        gpios = <&gpio4 19 GPIO_ACTIVE_HIGH>;
        /* test-gpios = <&gpio4 23 GPIO_ACTIVE_HIGH>; */
    };

